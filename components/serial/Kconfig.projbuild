## components/serial/Kconfig.projbuild
```kconfig
menu "Serial Configuration"

    config I2C_PORT
        int "I2C Port"
        default 1
        help
            I2C port to use.

    config UART_PORT
        int "UART Port"
        default 1
        help
            UART port to use.

    config I2S_PORT
        int "I2S Port"
        default 0
        help
            I2S port to use.
endmenu
```

## main/Kconfig.projbuild
```kconfig
menu "Weather Station Setup"

    choice STATION_TYPE
        prompt "Select the type of weather station to use."
        default OUTSIDE_STATION
        help
            Select the type of weather station to use. Different stations use different sensors.

        config OUTSIDE_STATION
            bool "outside"
        
        config INSIDE_STATION
            bool "inside"
        
        config WIND_AND_RAIN_STATION
            bool "wind&rain"
    
    endchoice

    config MQTT_BROKER_URI
        string "MQTT broker URI."
        help
            Define a MQTT broker to connect to. Leaving this blank disables MQTT.
    
    choice TEMPERATURE_SCALE
        prompt "Select which temperature scale to use."
        default CELSIUS
        help
            Select which temperature scale will be reported to clients.
        
        config CELSIUS
            bool "celsius"
        
        config FAHRENHEIT
            bool "fahrenheit"
        
        config KELVIN
            bool "kelvin"
    
    endchoice

    choice PRESSURE_SCALE
        prompt "Select which pressure scale to use."
        default MM_HG
        help
            Select which pressure scale will be reported to clients.
        
        config MM_HG
            bool "mmHg"
        
        config IN_HG
            bool "inHg"
    
    endchoice

    config DEFAULT_ELEVATION_METERS
        int "Default elevation in meters"
        default 0
        help
            Set the elevation in meters for use with barometer measurements.

endmenu
```
